## src/kernel/drivers/media/rc/irda/Kconfig
```kconfig
config OLIMEX_IRDA
	tristate "OLIMEX IRDA+ UEXT Module"
	depends on RC_CORE
	depends on I2C2_RK29 || I2C2_RK30
	select IR_RC5_DECODER
	---help---
	  Enable the OLIMEX UEXT IRDA+ module.
```

## src/kernel/drivers/net/wireless/rtl8712u/Kconfig
```kconfig
config RTL8712U
	tristate "Realtek 8712 USB WiFi"
	depends on USB
	select WIRELESS_EXT
    select WEXT_PRIV
    select IEEE80211
    select BT_RTKBTUSB
    select UHID
	---help---
	  Help message of RTL8712U
```
